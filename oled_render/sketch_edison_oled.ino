#include <SPI.h>

/*
  Blink
  Turns on an LED on for one second, then off for one second, repeatedly.
 
  This example code is in the public domain.
 */
 
// Pin 13 has an LED connected on most Arduino boards.
// give it a name:
#define OLED_SPI_CLK  13
#define OLED_SPI_CS   9
#define OLED_SPI_MOSI 11
#define OLED_CMD      8
#define USE_EMU_SPI

const unsigned char F16x16[] = 
{  	  
0x00,0x00,0x00,0x00,0x00,0x00,0x00,0x00,0x00,0x00,0x00,0x00,0x00,0x00,0x00,0x00,/*" ",0*/
0x00,0x00,0x00,0x00,0x00,0x00,0x00,0x00,0x00,0x00,0x00,0x00,0x00,0x00,0x00,0x00,/*" ",0*/

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0x00,0x04,0x04,0x04,0x04,0x0C,0x34,0x04,0x44,0x84,0x7F,0x04,0x04,0x04,0x00,0x00,/*"等",31*/
};

/************************************6*8的点阵************************************/
const unsigned char F6x8[][6] =		
{
0x00, 0x00, 0x00, 0x00, 0x00, 0x00,// sp
0x00, 0x00, 0x00, 0x2f, 0x00, 0x00,// !
0x00, 0x00, 0x07, 0x00, 0x07, 0x00,// "
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0x14, 0x14, 0x14, 0x14, 0x14, 0x14,// horiz lines
};
/****************************************8*16的点阵************************************/
const unsigned char F8X16[] = {
  0x00,0x00,0x00,0x00,0x00,0x00,0x00,0x00,0x00,0x00,0x00,0x00,0x00,0x00,0x00,0x00,// 0
  0x00,0x00,0x00,0xF8,0x00,0x00,0x00,0x00,0x00,0x00,0x00,0x33,0x30,0x00,0x00,0x00,//! 1
  0x00,0x10,0x0C,0x06,0x10,0x0C,0x06,0x00,0x00,0x00,0x00,0x00,0x00,0x00,0x00,0x00,//" 2
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  0x00,0x06,0x01,0x01,0x02,0x02,0x04,0x04,0x00,0x00,0x00,0x00,0x00,0x00,0x00,0x00,//~ 94
};
const unsigned char gImage_grid[1024] = { /* 0X22,0X01,0X80,0X00,0X40,0X00, */
0X00,0X00,0X00,0X00,0X00,0X00,0X00,0X00,0X00,0X00,0X00,0X00,0X00,0X00,0X00,0X00,
0X00,0X00,0X00,0X00,0X00,0X00,0X00,0X02,0X04,0X78,0X59,0X89,0X45,0X2F,0XBF,0X07,
0X01,0X00,0X00,0X10,0X00,0X20,0X00,0X40,0X00,0X80,0X80,0X40,0X20,0X10,0X00,0X04,
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0X18,0X10,0X11,0X13,0X17,0X16,0X14,0X1C,0X14,0X14,0X16,0X10,0X02,0X00,0X20,0X20,
};

const unsigned char gImage_slamtec[1024] = { /* 0X22,0X01,0X80,0X00,0X40,0X00, */
0X00,0X00,0X00,0X00,0X00,0X00,0X00,0X00,0X00,0X00,0X00,0X00,0X00,0X00,0X00,0X00,
0X00,0X00,0X00,0X00,0X00,0X00,0X00,0X00,0X00,0X00,0X00,0X00,0X00,0X00,0X00,0X00,
0X00,0X00,0X00,0X00,0X00,0X00,0X00,0X00,0X00,0X00,0X00,0X00,0X00,0X00,0X00,0X00,
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0X00,0X00,0X00,0X00,0X00,0X00,0X00,0X00,0X00,0X00,0X00,0X00,0X00,0X00,0X00,0X00,
};


#define XLevelL			0x00
#define XLevelH			0x10
#define XLevel	    ((XLevelH&0x0F)*16+XLevelL)
#define Max_Column	132
#define Max_Row			64
#define	Brightness	0xCF
#define X_WIDTH 		132
#define Y_WIDTH 		64


#define OLED_RST_Clr() 
#define OLED_RST_Set() 

#define OLED_DC_Clr() digitalWrite(OLED_CMD,0)
#define OLED_DC_Set() digitalWrite(OLED_CMD,1)   

#define OLED_SDA_Clr() digitalWrite(OLED_SPI_MOSI,0)
#define OLED_SDA_Set() digitalWrite(OLED_SPI_MOSI,1)   

#define OLED_SCL_Clr() digitalWrite(OLED_SPI_CLK,0)
#define OLED_SCL_Set() digitalWrite(OLED_SPI_CLK,1)    


void OLED_WrDat(unsigned char dat);//写数据
void OLED_WrCmd(unsigned char cmd);//写命令
void OLED_SetPos(unsigned char x, unsigned char y);//设置起始点坐标
void OLED_Fill(unsigned char bmp_dat);//全屏填充
void OLED_CLS(void);//清屏
void OLED_Init(void);//初始化
void OLED_6x8Str(unsigned char x, unsigned char y, unsigned char ch[]);
void OLED_8x16Str(unsigned char x, unsigned char y, unsigned char ch[]);
void OLED_16x16CN(unsigned char x, unsigned char y, unsigned char N);
void OLED_BMP(unsigned char x0, unsigned char y0, unsigned char x1, unsigned char y1, unsigned char BMP[]);



void OLED_WrDat(unsigned char dat)//写数据
{
	unsigned char i;
  digitalWrite(OLED_SPI_CS, 0);
	OLED_DC_Set();
#ifdef USE_EMU_SPI
	for(i=0;i<8;i++)
	{
		if((dat << i) & 0x80)
		{
			OLED_SDA_Set();
		}
		else
			OLED_SDA_Clr();
		OLED_SCL_Clr();
		OLED_SCL_Set();
      
	}
#else

  SPI.transfer(dat);
 
#endif
 digitalWrite(OLED_SPI_CS, 1);
}

void OLED_WrCmd(unsigned char cmd)//写命令
{
	unsigned char i;
 digitalWrite(OLED_SPI_CS, 0);
	OLED_DC_Clr();
          delay(1);
#ifdef USE_EMU_SPI
	for(i=0;i<8;i++) //发送一个八位数据
	{
		if((cmd << i) & 0x80)
		{
			OLED_SDA_Set();
		}
		else
		{
			OLED_SDA_Clr();
		}
		OLED_SCL_Clr();
		OLED_SCL_Set();
	}
#else

  SPI.transfer(cmd);

#endif
  digitalWrite(OLED_SPI_CS, 1);
}

void OLED_SetPos(unsigned char x, unsigned char y)//设置起始点坐标
{
	OLED_WrCmd(0xb0 + y);
	OLED_WrCmd(((x&0xf0)>>4)|0x10);
	OLED_WrCmd((x&0x0f));
}

void OLED_Fill(unsigned char bmp_dat)//全屏填充
{
	unsigned char y,x;
	for(y=0;y<8;y++)
	{
		OLED_WrCmd(0xb0+y);
		OLED_WrCmd(0x01);
		OLED_WrCmd(0x10);
		for(x=0;x<X_WIDTH;x++)
		{
			OLED_WrDat(bmp_dat);
		}
	}
}

void OLED_CLS(void)//清屏
{
	OLED_Fill(0x00);
}

void OLED_Init(void)
{	
	OLED_SCL_Set();
	OLED_RST_Clr();
	delay(500);
	OLED_RST_Set();
	
	OLED_WrCmd(0xAE);//--turn off oled panel
	
	OLED_WrCmd(0x02);//---set low column address
	OLED_WrCmd(0x10);//---set high column address
	
	OLED_WrCmd(0x40);//--set start line address  Set Mapping RAM Display Start Line (0x00~0x3F)
	
	OLED_WrCmd(0xB0);//--set contrast control register
	
	OLED_WrCmd(0x81); // Set SEG Output Current Brightness
	OLED_WrCmd(0xFF);//--Set SEG/Column Mapping     0xa0???? 0xa1??
	
	OLED_WrCmd(0xA1);//Set COM/Row Scan Direction   0xc0???? 0xc8??
	
	OLED_WrCmd(0xA6);//--set normal display
	
	OLED_WrCmd(0xA8);//--set multiplex ratio(1 to 64)
	OLED_WrCmd(0x3F);//--1/64 duty
	
	OLED_WrCmd(0xAD);//-set display offset	Shift Mapping RAM Counter (0x00~0x3F)
	OLED_WrCmd(0x8B);//-not offset
	
	OLED_WrCmd(0x33);//--set display clock divide ratio/oscillator frequency
	
	OLED_WrCmd(0xC8);//--set divide ratio, Set Clock as 100 Frames/Sec
	
	OLED_WrCmd(0xD3);//--set pre-charge period
	OLED_WrCmd(0x00);//Set Pre-Charge as 15 Clocks & Discharge as 1 Clock
	
	OLED_WrCmd(0xD5);//--set com pins hardware configuration
	OLED_WrCmd(0x80);
	
	OLED_WrCmd(0xD9);//--set vcomh
	OLED_WrCmd(0x1F);//Set VCOM Deselect Level
	
	OLED_WrCmd(0xDA);//-Set Page Addressing Mode (0x00/0x01/0x02)
	OLED_WrCmd(0x12);//
	
	OLED_WrCmd(0xDB);//--set Charge Pump enable/disable
	OLED_WrCmd(0x40);//--set(0x10) disable
    
	OLED_WrCmd(0xAF);//--turn on oled panel
	
	OLED_Fill(0x00);
	OLED_SetPos(0,0);
}

void OLED_6x8Str(unsigned char x, unsigned char y, unsigned char ch[])
{
	unsigned char c=0,i=0,j=0;
	while (ch[j]!='\0')
	{
		c = ch[j]-32;
		if(x>126)
		{
			x=0;y++;
		}
		OLED_SetPos(x,y);
		for(i=0;i<6;i++)
		{
			OLED_WrDat(F6x8[c][i]);
		}
		x+=6;
		j++;
	}
}

void OLED_8x16Str(unsigned char x, unsigned char y, unsigned char ch[])
{
	unsigned char c=0,i=0,j=0;
	while (ch[j]!='\0')
	{
		c =ch[j]-32;
		if(x>120)
		{
			x=0;y++;
		}
		OLED_SetPos(x,y);
		for(i=0;i<8;i++)
		{
			OLED_WrDat(F8X16[c*16+i]);
		}
		OLED_SetPos(x,y+1);
		for(i=0;i<8;i++)
		{
			OLED_WrDat(F8X16[c*16+i+8]);
		}
		x+=8;
		j++;
	}
}

void OLED_16x16CN(unsigned char x, unsigned char y, unsigned char N)
{
	unsigned char wm=0;
	unsigned int adder=32*N;
	OLED_SetPos(x+2 , y);
	for(wm = 0;wm < 16;wm++)
	{
		OLED_WrDat(F16x16[adder]);
		adder += 1;
	}
	OLED_SetPos(x+2,y + 1);
	for(wm = 0;wm < 16;wm++)
	{
		OLED_WrDat(F16x16[adder]);
		adder += 1;
	}
}

void OLED_BMP(unsigned char x0, unsigned char y0, unsigned char x1, unsigned char y1, unsigned char BMP[])
{
	unsigned int j=0;
	unsigned char x,y;

  
	for(y=y0;y<y1;y++)
	{
		OLED_SetPos(x0,y);
        for(x=x0;x<x1+x0;x++)
		{
            if (x<127) {
                OLED_WrDat(BMP[j++]);
            } else {
                j++;
            }
		}
	}

}


// the setup routine runs once when you press reset:
void setup() {                
  // initialize the digital pin as an output.


  pinMode(OLED_SPI_CS, OUTPUT);   

  pinMode(OLED_SPI_CLK, OUTPUT);  
  pinMode(OLED_SPI_MOSI, OUTPUT);     
  
#ifdef USE_EMU_SPI
  digitalWrite(OLED_SPI_CLK, 1);
  digitalWrite(OLED_SPI_MOSI, 1);
  digitalWrite(OLED_SPI_CS, 1);
  
 digitalWrite(OLED_SPI_CS, 0);
#else
  SPI.setDataMode(SPI_MODE2);
  SPI.setClockDivider(SPI_CLOCK_DIV2);
  SPI.setBitOrder(MSBFIRST);
  SPI.begin();
#endif
 
  pinMode(OLED_CMD, OUTPUT);    
  digitalWrite(OLED_CMD, 1);

  OLED_Init();
 // OLED_CLS();
  OLED_8x16Str(7,0, (unsigned char *)"Hello");
  delay(2000); 


}

// the loop routine runs over and over again forever:
void loop() {
 
  //OLED_BMP(0,0,128,8,(unsigned char *)gImage_grid);
  //OLED_BMP(0,0,128,8,(unsigned char *)gImage_slamtec);
  
 //delay(1000);
 // 
 // delay(1000);
 #if 1
 	unsigned int j=0;
	unsigned char x,y;

  
	for(y=0;y<8;y++)
	{
		OLED_SetPos(0,y);
            for(x=0;x<128;x++)
		{
            if (x<127) {
                OLED_WrDat(j++);
            } else {
                j++;
            }
            delay(10);
		}
	}

OLED_CLS();
#endif
}
